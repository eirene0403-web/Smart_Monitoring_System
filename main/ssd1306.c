#include <stdio.h>
#include "driver/i2c.h"
#include "ssd1306.h"
#include "esp_log.h"
#include "esp_err.h"

static const char *TAG = "SSD1306_128x32";

// ---------- I2C initialization ----------
void i2c_master_init(void) {
    i2c_config_t conf = {
        .mode = I2C_MODE_MASTER,
        .sda_io_num = I2C_MASTER_SDA_IO,
        .scl_io_num = I2C_MASTER_SCL_IO,
        .sda_pullup_en = GPIO_PULLUP_ENABLE,
        .scl_pullup_en = GPIO_PULLUP_ENABLE,
        .master.clk_speed = I2C_MASTER_FREQ_HZ,
    };
    ESP_ERROR_CHECK(i2c_param_config(I2C_MASTER_NUM, &conf));
    ESP_ERROR_CHECK(i2c_driver_install(I2C_MASTER_NUM, conf.mode, 0, 0, 0));
}

// ---------- Send one command byte ----------
static void oled_send_cmd(uint8_t cmd) {
    i2c_cmd_handle_t handle = i2c_cmd_link_create();
    i2c_master_start(handle);
    i2c_master_write_byte(handle, (OLED_ADDR << 1) | I2C_MASTER_WRITE, true);
    i2c_master_write_byte(handle, 0x00, true); // Control byte for command
    i2c_master_write_byte(handle, cmd, true);
    i2c_master_stop(handle);
    i2c_master_cmd_begin(I2C_MASTER_NUM, handle, pdMS_TO_TICKS(100));
    i2c_cmd_link_delete(handle);
}

// ---------- Send one data byte ----------
static void oled_send_data(uint8_t data) {
    i2c_cmd_handle_t handle = i2c_cmd_link_create();
    i2c_master_start(handle);
    i2c_master_write_byte(handle, (OLED_ADDR << 1) | I2C_MASTER_WRITE, true);
    i2c_master_write_byte(handle, 0x40, true); // Control byte for data
    i2c_master_write_byte(handle, data, true);
    i2c_master_stop(handle);
    esp_err_t ret=i2c_master_cmd_begin(I2C_MASTER_NUM, handle, pdMS_TO_TICKS(100));
    i2c_cmd_link_delete(handle);
    ESP_LOGI(TAG, "I2C test write to OLED: %s", ret == ESP_OK ? "OK" : "FAIL");
}

// ---------- Initialize OLED 128x32 ----------
void oled_init(void) {
    uint8_t init_cmds[] = {
        0xAE,       // Display OFF
        0x20, 0x00, // Horizontal addressing mode
        0xB0,       // Page start address
        0xC8,       // COM output scan direction
        0x00,       // Low column start address
        0x10,       // High column start address
        0x40,       // Start line address
        0x81, 0x7F, // Contrast
        0xA1,       // Segment remap
        0xA6,       // Normal display (not inverted)
        0xA8, 0x1F, // Multiplex ratio for 128x32 (31)
        0xA4,       // Resume to RAM content display
        0xD3, 0x00, // Display offset
        0xD5, 0xF0, // Display clock divide
        0xD9, 0x22, // Pre-charge period
        0xDA, 0x02, // COM pins hardware config for 128x32
        0xDB, 0x20, // VCOM deselect level
        0x8D, 0x14, // Enable charge pump
        0xAF        // Display ON
    };

    for (int i = 0; i < sizeof(init_cmds); i++) {
        oled_send_cmd(init_cmds[i]);
    }

    ESP_LOGI(TAG, "OLED 128x32 initialized");
}

// ---------- Clear screen ----------
void oled_clear(void) {
    for (uint8_t page = 0; page < 4; page++) { // only 4 pages
        oled_send_cmd(0xB0 + page);
        oled_send_cmd(0x00);
        oled_send_cmd(0x10);
        for (uint8_t col = 0; col < 128; col++) {
            oled_send_data(0x00);
        }
    }
}

// ---------- Set cursor ----------
void oled_set_cursor(uint8_t page, uint8_t column) {
    oled_send_cmd(0xB0 + page);
    oled_send_cmd(0x00 + (column & 0x0F));
    oled_send_cmd(0x10 + ((column >> 4) & 0x0F));
}

// ---------- 5x7 font (basic ASCII subset) ----------
//get from https://www.cl.cam.ac.uk/teaching/1314/P31/nokia/nokia_lcd.c
static const uint8_t font5x7[][5] = {
    // space to ~
  {0x00, 0x00, 0x00, 0x00, 0x00}, // 20  
  {0x00, 0x00, 0x5f, 0x00, 0x00}, // 21 !
  {0x00, 0x07, 0x00, 0x07, 0x00}, // 22 "
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  {0x78, 0x46, 0x41, 0x46, 0x78} // 7f DEL
};

// ---------- Draw one character ----------
static void oled_write_char(char c) {
    if (c < 32 || c > 126) c = '?';
    for (int i = 0; i < 5; i++) oled_send_data(font5x7[c - 32][i]);
    oled_send_data(0x00);
}

// ---------- Draw string ----------
void oled_write_str(const char *str) {
    while (*str) oled_write_char(*str++);
}